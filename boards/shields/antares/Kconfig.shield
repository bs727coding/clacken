## boards/shields/antares/Kconfig.shield
```kconfig
config SHIELD_ANTARES_LEFT
	def_bool $(shields_list_contains,antares_left)

config SHIELD_ANTARES_RIGHT
	def_bool $(shields_list_contains,antares_right)
```

## boards/shields/clacken/Kconfig.defconfig
```kconfig
if SHIELD_CLACKEN_LEFT

config ZMK_KEYBOARD_NAME
    default "Clacken"

config ZMK_SPLIT_ROLE_CENTRAL
    default y

config ZMK_STUDIO
    default n

config CONFIG_ZMK_BLE_EXPERIMENTAL_CONN
    def_bool y

config CONFIG_ZMK_HID_REPORT_TYPE_NKRO
    def_bool n

endif


if SHIELD_CLACKEN_LEFT || SHIELD_CLACKEN_RIGHT

config ZMK_SPLIT
    default y

endif
```

## boards/shields/clacken/Kconfig.shield
```kconfig
config SHIELD_CLACKEN_LEFT
	def_bool $(shields_list_contains,clacken_left)

config SHIELD_CLACKEN_RIGHT
	def_bool $(shields_list_contains,clacken_right)
```
